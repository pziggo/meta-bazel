## conf/layer.conf
```bitbake
# We have a conf and classes directory, add to BBPATH
BBPATH .= ":${LAYERDIR}"

# We have recipes-* directories, add to BBFILES
BBFILES += "${LAYERDIR}/recipes-*/*/*.bb"

BBFILE_COLLECTIONS += "bazel"
BBFILE_PATTERN_bazel = "^${LAYERDIR}/"
BBFILE_PRIORITY_bazel = "10"

LAYERSERIES_COMPAT_bazel = "kirkstone"
LAYERDEPENDS_bazel = "core"
```
